## base_external/Config.in
```kconfig
source "$BR2_EXTERNAL_AESD_FINAL_PROJECT_PATH/package/camera-server/Config.in"
source "$BR2_EXTERNAL_AESD_FINAL_PROJECT_PATH/package/status-led/Config.in"
```

## base_external/package/status-led/Config.in
```kconfig
config BR2_PACKAGE_STATUS_LED
	bool "status-led"
	depends on BR2_LINUX_KERNEL
	depends on BR2_PACKAGE_RPI_FIRMWARE
	help
	  Kernel module providing /dev/status_led to control the Raspberry Pi onboard
	  ACT LED. Source in driver/ of the project repository.
```
